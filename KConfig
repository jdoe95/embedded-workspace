## source/KConfig
```kconfig
# source/KConfig
rsource "variant/$VARIANT/KConfig"
rsource "googletest/KConfig"
```

## source/algorithm/KConfig
```kconfig
# source/algorithm/KConfig
menu "Algorithm"
	rsource "crc/KConfig"
	config ALGO_SHA256
		bool "SHA-256"
		select PLAT_UNALIGNED
		select PLAT_BYTESWAP
		select PLAT_MEMFILL
endmenu
```

## source/algorithm/crc/KConfig
```kconfig
# source/algorithm/crc/KConfig
config ALGO_CRC
	bool

choice
	prompt "CRC internal implementation"
	depends on ALGO_CRC

	config ALGO_CRC_TABLE
		bool "table-based"

	config ALGO_CRC_LOOP
		bool "loop-based"
endchoice

config ALGO_CRC32_MF
	bool
	select ALGO_CRC

config ALGO_CRC32_LF
	bool
	select ALGO_CRC

config ALGO_CRC16_MF
	bool
	select ALGO_CRC

config ALGO_CRC16_LF
	bool
	select ALGO_CRC

config ALGO_CRC8_MF
	bool
	select ALGO_CRC

config ALGO_CRC8_LF
	bool
	select ALGO_CRC

# CRC tables
config ALGO_CRC32_TABLE_IEEE
	bool

config ALGO_CRC16_TABLE_MODBUS
	bool

# CRC info blocks
config ALGO_CRC32_IEEE
	bool "CRC32-IEEE"
	select ALGO_CRC32_LF
	select ALGO_CRC32_TABLE_IEEE if ALGO_CRC_TABLE

config ALGO_CRC16_MODBUS
	bool "CRC16-MODBUS"
	select ALGO_CRC16_LF
	select ALGO_CRC16_TABLE_MODBUS if ALGO_CRC_TABLE
```

## source/googletest/KConfig
```kconfig
# source/googletest/KConfig
config GTEST
	bool "GoogleTest"

config GMOCK
	bool "GoogleMock"
	select GTEST

menu "GoogleTest Framework Settings"
	depends on GTEST

	choice
		prompt "GTEST_HAS_CLONE"
		optional

		config GTEST_HASCLONE_1
			bool "1"

		config GTEST_HASCLONE_0
			bool "0"
	endchoice

	choice
		prompt "GTEST_HAS_EXCEPTIONS"
		optional

		config GTEST_HASEXCEPTIONS_1
			bool "1"

		config GTEST_HASEXCEPTIONS_0
			bool "0"
	endchoice

	choice
		prompt "GTEST_HAS_POSIX_RE"
		optional

		config GTEST_HASPOSIX_RE_1
			bool "1"

		config GTEST_HASPOSIX_RE_0
			bool "0"
	endchoice

	choice
		prompt "GTEST_HAS_PTHREAD"
		optional

		config GTEST_HASPTHREAD_1
			bool "1"

		config GTEST_HASPTHREAD_0
			bool "0"
	endchoice

	choice
		prompt "GTEST_HAS_RTTI"
		optional

		config GTEST_HASRTTI_1
			bool "1"

		config GTEST_HASRTTI_0
			bool "0"
	endchoice

	choice
		prompt "GTEST_HAS_STD_WSTRING"
		optional

		config GTEST_HASSTDWSTRING_1
			bool "1"

		config GTEST_HASSTDWSTRING_0
			bool "0"
	endchoice

	choice
		prompt "GTEST_HAS_SEH"
		optional

		config GTEST_HASSEH_1
			bool "1"

		config GTEST_HASSEH_0
			bool "0"
	endchoice

	choice
		prompt "GTEST_HAS_STREAM_REDIRECTION"
		optional

		config GTEST_HASSTREAMREDIRECTION_1
			bool "1"

		config GTEST_HASSTREAMREDIRECTION_0
			bool "0"
	endchoice

	choice
		prompt "GTEST_LINKED_AS_SHARED_LIBRARY"
		optional

		config GTEST_LINKEDASSHAREDLIBRARY_1
			bool "1"

		config GTEST_LINKEDASSHAREDLIBRARY_0
			bool "0"
	endchoice

	choice
		prompt "GTEST_CREATE_SHARED_LIBRARY"
		optional

		config GTEST_CREATESHAREDLIBRARY_1
			bool "1"

		config GTEST_CREATESHAREDLIBRARY_0
			bool "0"
	endchoice

	choice
		prompt "GTEST_DEFAULT_DEATH_TEST_STYLE"
		optional
		config GTEST_DEFAULTDEATHTEST_THREADSAFE
			bool "threadsafe"

		config GTEST_DEFAULTDEATHTEST_FAST
			bool "fast"
	endchoice
endmenu
```

## source/platform/KConfig
```kconfig
# source/platform/KConfig
menu "Platform"
	config PLAT_NOCONTEND
		bool "Disable CONTEND assertion"

	config PLAT_USE_CONTEND_FAIL
		bool "Use contend_fail() even if assert() is available"
		depends on !PLAT_NOCONTEND

	choice
		prompt "Override default endianness"
		optional

		config PLAT_ENDIAN_BIG
			bool "big"

		config PLAT_ENDIAN_LITTLE
			bool "little"

		config PLAT_ENDIAN_PDP
			bool "pdp-11"

		config PLAT_ENDIAN_HS316
			bool "honeywell-316"
	endchoice

	config PLAT_BYTESWAP
		bool "Byteswap functions"

	config PLAT_BYTESWAP_NOGENERIC
		bool
		depends on PLAT_BYTESWAP

	config PLAT_BITREVERSE
		bool "Bit reverse functions"

	config PLAT_BITREVERSE_NOGENERIC
		bool
		depends on PLAT_BITREVERSE

	config PLAT_MEMFILL
		bool "Memory filling routines"

	config PLAT_UNALIGNED
		bool "Unaligned access routines"
endmenu
```

## source/protocol/ethernet/KConfig
```kconfig
# source/protocol/ethernet/KConfig
config PROTO_ETH
	bool "Ethernet Protocol"

menu "Ethernet Protocol Settings"
	depends on PROTO_ETH

	config PROTO_ETH_PAD
		bool "Use software to pad packet to minimum size"
		select PLAT_MEMFILL

	config PROTO_ETH_CHECKSUM
		bool "Use software to calculate frame check sequence"
		select PROTO_ETH_PAD
		select ALGO_CRC32_IEEE
		select PLAT_UNALIGNED
		select PLAT_BYTESWAP

	config PROTO_ETH_MAXPAYLOAD
		int "Maximum payload size"
		depends on PROTO_ETH_PAD || PROTO_ETH_CHECKSUM
		range 0 1500
		default 1500
endmenu
```

## source/testing/KConfig
```kconfig
# source/testing/KConfig
config TESTING
	bool "Unit Testing"

menu "Unit Tests"
	depends on TESTING
	rsource "platform/KConfig"
	rsource "algorithm/KConfig"
	rsource "utility/KConfig"
endmenu
```

## source/testing/algorithm/KConfig
```kconfig
# source/testing/algorithm/KConfig
rsource "crc/KConfig"

config TEST_ALGO_SHA256
	bool "algorithm/SHA256 unit tests"
	select ALGO_SHA256
	select GMOCK
```

## source/testing/algorithm/crc/KConfig
```kconfig
# source/testing/algorithm/KConfig
config TEST_ALGO_CRC32_MF
	bool
	select GTEST
	select ALGO_CRC32_MF

config TEST_ALGO_CRC32_LF
	bool
	select GTEST
	select ALGO_CRC32_LF

config TEST_ALGO_CRC16_MF
	bool
	select GTEST
	select ALGO_CRC16_MF

config TEST_ALGO_CRC16_LF
	bool
	select GTEST
	select ALGO_CRC16_LF

config TEST_ALGO_CRC8_MF
	bool
	select GTEST
	select ALGO_CRC8_MF

config TEST_ALGO_CRC8_LF
	bool
	select GTEST
	select ALGO_CRC8_LF

config TEST_ALGO_CRC32_IEEE
	bool "algorithm/CRC32-IEEE unit tests"
	select TEST_ALGO_CRC32_LF
	select ALGO_CRC32_IEEE

config TEST_ALGO_CRC16_MODBUS
	bool "algorithm/CRC16-MODBUS unit tests"
	select TEST_ALGO_CRC16_LF
	select ALGO_CRC16_MODBUS
```

## source/testing/platform/KConfig
```kconfig
# source/testing/platform/KConfig
config TEST_PLAT_BYTESWAP
	bool "platform/byteswap unit tests"
	select PLAT_BYTESWAP
	select GTEST

config TEST_PLAT_BITREVERSE
	bool "platform/bitreverse unit tests"
	select PLAT_BITREVERSE
	select GTEST

config TEST_PLAT_MEMFILL
	bool "platform/memfill unit tests"
	select PLAT_MEMFILL
	select GMOCK
```

## source/testing/utility/KConfig
```kconfig
# source/testing/utility/KConfig
config TEST_UTIL_LINKQ
	bool "utility/linkq unit tests"
	select UTIL_LINKQ
	select GTEST
```

## source/utility/KConfig
```kconfig
# source/utility/KConfig
menu "Utility"
	config UTIL_SOFTIRQ
		bool "SoftIRQ work deferral routines"

	config UTIL_LINKQ
		bool "Doubly linked queue"
endmenu
```
